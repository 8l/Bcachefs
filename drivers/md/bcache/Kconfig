## drivers/md/bcache/Kconfig
```kconfig
config BCACHE
	tristate "Block device as cache"
	select LIBCRC32C
	---help---
	Allows a block device to be used as cache for other devices; uses
	a btree for indexing and the layout is optimized for SSDs.

	See Documentation/bcache.txt for details.

config BCACHE_DEBUG
	bool "Bcache debugging"
	depends on BCACHE
	---help---
	Don't select this option unless you're a developer

	Enables extra debugging tools, allows expensive runtime checks to be
	turned on.

config SIX_LOCKS_DEBUG
	bool "SIX locks debugging"
	depends on BCACHE
	---help---
	Don't select this option unless you're a developer

	Enables SIX lock tracepoints.

config BCACHE_NO_IO
	bool "Disable IO to underlying device"
	depends on BCACHE
	---help---
	Stubs out all the actual IO calls
```
